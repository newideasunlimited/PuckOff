## CMakeLists.txt
```
# SPDX-License-Identifier: Apache-2.0
cmake_minimum_required(VERSION 3.20.0)

find_package(Zephyr REQUIRED HINTS $ENV{ZEPHYR_BASE})
project(puckoff)

target_sources(app PRIVATE src/gamepad.c)

if(CONFIG_PUCKOFF_TRANSPORT_USB_RAW_RF)
	if(CONFIG_BT OR CONFIG_MPSL)
		message(FATAL_ERROR
			"The raw RF driver owns RADIO exclusively. Disable Bluetooth/MPSL "
			"or select the isolated BLE diagnostic configuration.")
	endif()
	target_sources(app PRIVATE
		src/main.c
		src/radio.c
		src/link.c
		src/bond.c
		src/input.c
		src/usb.c
	)
	target_sources_ifdef(CONFIG_PUCKOFF_USB_SWITCH app PRIVATE src/usb_switch.c)
	target_sources_ifdef(CONFIG_PUCKOFF_SNIFFER app PRIVATE src/sniff.c)
	target_sources_ifdef(CONFIG_SHELL app PRIVATE src/console.c)
elseif(CONFIG_PUCKOFF_TRANSPORT_BLE_DIAGNOSTIC)
	if(NOT CONFIG_BT_LL_SOFTDEVICE)
		message(FATAL_ERROR "The BLE diagnostic requires the Nordic SoftDevice Controller.")
	endif()
	target_sources(app PRIVATE
		src/ble/diagnostic.c
		src/ble/gamepad.c
		src/ble/report_state.c
	)
elseif(CONFIG_PUCKOFF_TRANSPORT_BLE_BRIDGE)
	if(CONFIG_MPSL_TIMESLOT_SESSION_COUNT LESS 1)
		message(FATAL_ERROR "The BLE bridge needs one MPSL timeslot session.")
	endif()
	target_sources(app PRIVATE
		src/main.c
		src/radio_timeslot.c
		src/link.c
		src/bond.c
		src/input.c
		src/usb.c
		src/console.c
		src/ble/bridge.c
		src/ble/bridge_shell.c
		src/ble/gamepad.c
		src/ble/hid_map.c
		src/ble/modes.c
		src/ble/remote.c
		src/ble/report_state.c
	)
else()
	message(FATAL_ERROR "Select exactly one PuckOff transport and radio owner.")
endif()

target_sources_ifdef(CONFIG_PUCKOFF_BOOT_GUARD app PRIVATE src/boot_guard.c)
```

## Kconfig
```
# SPDX-License-Identifier: Apache-2.0
mainmenu "PuckOff firmware"

rsource "Kconfig.transport"
rsource "Kconfig.usb"
rsource "Kconfig.guard"
source "Kconfig.zephyr"
```

## Kconfig.guard
```
# SPDX-License-Identifier: Apache-2.0

config PUCKOFF_BOOT_GUARD
	bool "Watchdog boot guard with safe mode and UF2 fallback"
	depends on SOC_NRF52840
	select REBOOT
	help
	  Arm the hardware watchdog before the kernel starts and record how far
	  each boot gets in retained RAM. After a watchdog reset, a boot that hung
	  after main() comes up in safe mode (USB gamepad and console only), and
	  a boot that hung before main() goes straight to the UF2 drive. The
	  `bootloader` command then lets the watchdog perform the reset, so the
	  drive never starts with a watchdog still counting. Intended for
	  hardware-untested images; it does not modify the bootloader.

config PUCKOFF_BOOT_GUARD_TIMEOUT_S
	int "Watchdog timeout in seconds"
	depends on PUCKOFF_BOOT_GUARD
	range 2 60
	default 10
	help
	  The watchdog is fed from the system work queue every quarter of this
	  period. Entering the UF2 drive from the console takes up to this long.

config PUCKOFF_BOOT_GUARD_MAX_RUNTIME_RESETS
	int "Consecutive watchdog resets of a ready receiver before safe mode"
	depends on PUCKOFF_BOOT_GUARD
	range 1 20
	default 3
	help
	  A receiver that was fully running restarts normally after a watchdog
	  reset. After this many in a row without a clean boot in between, it
	  starts in safe mode instead so the fault can be inspected.
```

## Kconfig.transport
```
# SPDX-License-Identifier: Apache-2.0

choice PUCKOFF_TRANSPORT
	prompt "PuckOff transport and radio owner"
	default PUCKOFF_TRANSPORT_USB_RAW_RF

config PUCKOFF_TRANSPORT_USB_RAW_RF
	bool "USB gamepad with exclusive proprietary radio"
	help
	  The default receiver. Bluetooth and MPSL must be disabled because the
	  polling driver owns RADIO directly.

config PUCKOFF_TRANSPORT_BLE_DIAGNOSTIC
	bool "BLE HID diagnostic (no controller radio)"
	depends on SOC_NRF52840 && BT && BT_PERIPHERAL
	help
	  Advertise a BLE HID gamepad, with neutral input and explicit serial
	  diagnostic commands only. This is not a Steam Controller receiver.
	  The raw radio driver and controller link are not compiled.

config PUCKOFF_TRANSPORT_BLE_BRIDGE
	bool "Controller to a Bluetooth LE gamepad, sharing the radio"
	depends on SOC_NRF52840 && BT && BT_PERIPHERAL && BT_LL_SOFTDEVICE
	help
	  The controller link runs inside MPSL timeslots next to the SoftDevice
	  Controller, and controller input goes to one connected BLE HID host.
	  With no BLE host connected, input goes to the USB gamepad instead.

endchoice

config PUCKOFF_BLE_GAMEPAD_ONLY
	bool "Expose only the gamepad collection over Bluetooth"
	depends on PUCKOFF_TRANSPORT_BLE_BRIDGE || PUCKOFF_TRANSPORT_BLE_DIAGNOSTIC
	help
	  The report map and the HID service carry the gamepad report only; the
	  keyboard, mouse and consumer collections used by TV remote mode are
	  left out and "ble mode remote" is refused. macOS treats a device that
	  also carries a keyboard collection as a protected input device and
	  does not hand its gamepad reports to apps. The host sees a different
	  GATT database, so forget and re-pair the board after changing this.

config PUCKOFF_SNIFFER
	bool "Passive link sniffer instead of the receiver"
	depends on PUCKOFF_TRANSPORT_USB_RAW_RF && SHELL
	help
	  Never transmit. Follow another receiver's advertisements from the
	  rendezvous address to its session and print the packets exchanged
	  there on the console, so over-air formats can be confirmed from our
	  own captures. The controller link, polling and USB input are off;
	  pairing identifiers and session addresses are never printed.
```

## Kconfig.usb
```
# SPDX-License-Identifier: Apache-2.0

choice PUCKOFF_USB_MODE
	prompt "USB gamepad profile"
	depends on USB_DEVICE_STACK_NEXT && PUCKOFF_TRANSPORT_USB_RAW_RF
	default PUCKOFF_USB_GENERIC

config PUCKOFF_USB_GENERIC
	bool "Generic HID gamepad (default)"
	help
	  PuckOff's 13-byte HID input report with analog triggers and a serial
	  setup console. Host and game compatibility must be tested separately.
	  The current 1209:0001 identity is reserved for private testing, is not
	  unique, and must not be used on redistributed, sold, or manufactured
	  devices. Allocate a product identity before distributing hardware.

config PUCKOFF_USB_SWITCH
	bool "Experimental wired Switch / Pokken-style HID"
	depends on !USBD_CDC_ACM_CLASS
	help
	  Opt-in, single-interface USB HID profile with 8-byte input/output
	  reports and digital triggers. Requires modes/switch.conf and
	  modes/switch.overlay together. No serial console, rumble, IMU,
	  capture button, or Xbox/PlayStation console authentication.
	  Uses a third-party USB identity for interoperability experiments;
	  not an allocated PuckOff product ID or a hardware-verified claim.

endchoice

config PUCKOFF_USB_BOOTLOADER_REPORT
	bool "Reboot to UF2 when the host sends the bootloader output report"
	depends on PUCKOFF_USB_SWITCH && BOARD_PROMICRO_NRF52840_NRF52840_UF2
	default y
	select REBOOT
	help
	  The standalone Switch image has no serial console, so this is its
	  software route back to the Adafruit UF2 bootloader: an eight-byte
	  output report equal to SWITCH_BOOTLOADER_REPORT (ASCII "PuckOff"
	  followed by 0x57) reboots the board into the bootloader about 50 ms
	  later. tools/puckoff_bootloader.py sends it. Any USB host can send
	  the report; it only ever leads to the bootloader, never to a flash
	  write, and physical reset access should still be preserved.

config PUCKOFF_USB_TEST_RECOVERY
	bool "DEVELOPMENT ONLY: return to UF2 after 120 seconds"
	depends on PUCKOFF_USB_SWITCH && BOARD_PROMICRO_NRF52840_NRF52840_UF2
	select REBOOT
	help
	  For an unattended USB experiment, reboot to the Adafruit UF2
	  bootloader 120 seconds after usb_start(), without a serial console
	  or host command. This requires the same bootloader as the existing
	  console bootloader command. Never enable in a normal playing image.
	  This application timer does not recover a board that cannot boot
	  or whose kernel/workqueue stops running; retain physical reset access.

# Pairing buffers and the shell stack apply to every image with the setup
# console (generic USB and the BLE bridge), not to the standalone Switch profile.
# setup status builds a 1 KB line on the shell thread; the Zephyr default stack
# overflows there, which the boot guard reported as kernel fault 2.
config SHELL_BACKEND_SERIAL_RX_RING_BUFFER_SIZE
	default 256
	depends on (PUCKOFF_USB_GENERIC || PUCKOFF_TRANSPORT_BLE_BRIDGE) && SHELL && SHELL_BACKENDS && SHELL_BACKEND_SERIAL
	depends on SHELL_BACKEND_SERIAL_API_INTERRUPT_DRIVEN || SHELL_BACKEND_SERIAL_API_POLLING

config SHELL_CMD_BUFF_SIZE
	default 256
	depends on (PUCKOFF_USB_GENERIC || PUCKOFF_TRANSPORT_BLE_BRIDGE) && SHELL

config SHELL_STACK_SIZE
	default 3072
	depends on (PUCKOFF_USB_GENERIC || PUCKOFF_TRANSPORT_BLE_BRIDGE) && SHELL
```

## prj.conf
```kconfig
# SPDX-License-Identifier: Apache-2.0
CONFIG_GPIO=y
CONFIG_HWINFO=y

# USB: our own device with a serial console plus a gamepad.
CONFIG_USB_DEVICE_STACK_NEXT=y
CONFIG_CDC_ACM_SERIAL_INITIALIZE_AT_BOOT=n
CONFIG_USBD_CDC_ACM_CLASS=y
CONFIG_USBD_HID_SUPPORT=y
CONFIG_UART_LINE_CTRL=y

# Console and shell on the USB serial port.
CONFIG_SERIAL=y
CONFIG_CONSOLE=y
CONFIG_UART_CONSOLE=y
CONFIG_SHELL=y
CONFIG_SHELL_BACKEND_SERIAL=y
CONFIG_SHELL_PROMPT_UART="puckoff:~$ "
CONFIG_SHELL_BACKEND_SERIAL_CHECK_DTR=y
# Pairing buffer sizes are conditional defaults in Kconfig.usb.
CONFIG_SHELL_METAKEYS=y
CONFIG_SHELL_ECHO_STATUS=y
CONFIG_SHELL_VT100_COMMANDS=y
# Pairing import commands contain private records; do not retain command history.
CONFIG_SHELL_HISTORY=n

CONFIG_LOG=y
CONFIG_LOG_MODE_DEFERRED=y
CONFIG_USBD_LOG_LEVEL_WRN=y
CONFIG_USBD_HID_LOG_LEVEL_WRN=y
CONFIG_UDC_DRIVER_LOG_LEVEL_WRN=y

# Remember the pairing across power cycles.
CONFIG_FLASH=y
CONFIG_FLASH_MAP=y
CONFIG_NVS=y
CONFIG_SETTINGS=y
CONFIG_SETTINGS_NVS=y

CONFIG_MAIN_STACK_SIZE=2048
CONFIG_CLOCK_CONTROL=y
CONFIG_REBOOT=y
```

## ble-bridge.conf
```kconfig
# SPDX-License-Identifier: Apache-2.0
# Overlay on prj.conf: build with -DEXTRA_CONF_FILE=ble-bridge.conf
CONFIG_PUCKOFF_TRANSPORT_BLE_BRIDGE=y

CONFIG_BT=y
CONFIG_BT_PERIPHERAL=y
CONFIG_BT_LL_SOFTDEVICE=y
CONFIG_BT_SMP=y
CONFIG_BT_BONDABLE=y
CONFIG_BT_MAX_CONN=1
# A board can move between a few TVs, phones and computers without re-pairing.
CONFIG_BT_MAX_PAIRED=4
CONFIG_BT_SETTINGS=y
CONFIG_BT_DEVICE_NAME="PuckOff"
CONFIG_BT_DEVICE_APPEARANCE=964
CONFIG_BT_ATT_TX_COUNT=2
CONFIG_BT_GATT_AUTO_SEC_REQ=n
CONFIG_BT_AUTO_PHY_UPDATE=n
CONFIG_BT_PERIPHERAL_PREF_MIN_INT=6
CONFIG_BT_PERIPHERAL_PREF_MAX_INT=12
CONFIG_BT_PERIPHERAL_PREF_LATENCY=0
CONFIG_BT_PERIPHERAL_PREF_TIMEOUT=400
CONFIG_BT_DIS=y
CONFIG_BT_DIS_MANUF_NAME=y
CONFIG_BT_DIS_MANUF_NAME_STR="New Ideas Unlimited, LLC"
CONFIG_BT_DIS_MODEL_NUMBER=y
CONFIG_BT_DIS_MODEL_NUMBER_STR="PuckOff BLE bridge"
# PnP ID with a USB-style vendor/product ID. Without it macOS treats the
# device as an Apple-protocol (MFi) controller and delivers no input to
# apps, even though the HID reports arrive. Same IDs as the USB image.
CONFIG_BT_DIS_PNP=y
CONFIG_BT_DIS_PNP_VID_SRC=2
CONFIG_BT_DIS_PNP_VID=0x1209
CONFIG_BT_DIS_PNP_PID=0x0001
CONFIG_BT_DIS_PNP_VER=0x0001

# The controller link borrows the radio between Bluetooth events.
CONFIG_MPSL_TIMESLOT_SESSION_COUNT=1

# Many Pro Micro nRF52840 clones have no 32.768 kHz crystal. The default
# image only survives on them because Zephyr's two-stage LFXO start runs on
# the RC oscillator while it waits for a crystal that never comes; the
# SoftDevice Controller waits for that crystal too, and the board hangs.
# The calibrated RC oscillator works on every board.
CONFIG_CLOCK_CONTROL_NRF_K32SRC_RC=y
CONFIG_CLOCK_CONTROL_NRF_K32SRC_RC_CALIBRATION=y

# Hardware-untested build: recover from a hung boot without a paperclip, and
# record kernel faults and stack assertions for the next boot. Needs
# ble-bridge.overlay for the retained RAM region.
CONFIG_PUCKOFF_BOOT_GUARD=y
CONFIG_MPSL_ASSERT_HANDLER=y
CONFIG_BT_CTLR_ASSERT_HANDLER=y

CONFIG_SYSTEM_WORKQUEUE_STACK_SIZE=2048
CONFIG_BT_TX_PROCESSOR_STACK_SIZE=1024
```

## ble-diagnostic.conf
```kconfig
# SPDX-License-Identifier: Apache-2.0
# Standalone CONF_FILE, not an overlay on the default receiver configuration.
CONFIG_PUCKOFF_TRANSPORT_BLE_DIAGNOSTIC=y
CONFIG_GPIO=y
CONFIG_REBOOT=y

CONFIG_BT=y
CONFIG_BT_PERIPHERAL=y
CONFIG_BT_LL_SOFTDEVICE=y
CONFIG_BT_SMP=y
CONFIG_BT_BONDABLE=y
CONFIG_BT_MAX_CONN=1
CONFIG_BT_MAX_PAIRED=1
CONFIG_BT_SETTINGS=y
CONFIG_BT_DEVICE_NAME="PuckOff BLE diagnostic"
CONFIG_BT_DEVICE_APPEARANCE=964
CONFIG_BT_ATT_TX_COUNT=2
CONFIG_BT_GATT_AUTO_SEC_REQ=n
CONFIG_BT_AUTO_PHY_UPDATE=n
CONFIG_BT_PERIPHERAL_PREF_MIN_INT=6
CONFIG_BT_PERIPHERAL_PREF_MAX_INT=12
CONFIG_BT_PERIPHERAL_PREF_LATENCY=0
CONFIG_BT_PERIPHERAL_PREF_TIMEOUT=400
CONFIG_BT_DIS=y
CONFIG_BT_DIS_MANUF_NAME=y
CONFIG_BT_DIS_MANUF_NAME_STR="New Ideas Unlimited, LLC"
CONFIG_BT_DIS_MODEL_NUMBER=y
CONFIG_BT_DIS_MODEL_NUMBER_STR="BLE-only diagnostic"
CONFIG_BT_DIS_PNP=n

CONFIG_FLASH=y
CONFIG_FLASH_MAP=y
CONFIG_NVS=y
CONFIG_SETTINGS=y
CONFIG_SETTINGS_NVS=y

# USB is a diagnostic serial port, not a gamepad or a prerequisite for BLE.
CONFIG_USB_DEVICE_STACK_NEXT=y
CONFIG_USBD_CDC_ACM_CLASS=y
CONFIG_CDC_ACM_SERIAL_INITIALIZE_AT_BOOT=y
CONFIG_CDC_ACM_SERIAL_MANUFACTURER_STRING="New Ideas Unlimited, LLC"
CONFIG_CDC_ACM_SERIAL_PRODUCT_STRING="PuckOff BLE diagnostic"
# Same temporary pid.codes test identity as the default firmware, not allocated.
CONFIG_CDC_ACM_SERIAL_VID=0x1209
CONFIG_CDC_ACM_SERIAL_PID=0x0001
CONFIG_UART_LINE_CTRL=y
CONFIG_SERIAL=y
CONFIG_CONSOLE=y
CONFIG_UART_CONSOLE=y
CONFIG_SHELL=y
CONFIG_SHELL_BACKEND_SERIAL=y
CONFIG_SHELL_BACKEND_SERIAL_CHECK_DTR=y
CONFIG_SHELL_PROMPT_UART="ble-diagnostic:~$ "
CONFIG_LOG=y
CONFIG_LOG_MODE_DEFERRED=y
CONFIG_USBD_LOG_LEVEL_WRN=y
CONFIG_UDC_DRIVER_LOG_LEVEL_WRN=y
CONFIG_MAIN_STACK_SIZE=2048
CONFIG_SYSTEM_WORKQUEUE_STACK_SIZE=2048
CONFIG_BT_TX_PROCESSOR_STACK_SIZE=1024
```

## ble-rf.conf
```kconfig
# SPDX-License-Identifier: Apache-2.0
# EXTRA_CONF_FILE on ble-diagnostic.conf; selects the real RF backend, not manual input.
CONFIG_PUCKOFF_TRANSPORT_BLE_DIAGNOSTIC=n
CONFIG_PUCKOFF_TRANSPORT_BLE_RF=y
CONFIG_HWINFO=y
CONFIG_MPSL_TIMESLOT_SESSION_COUNT=1
CONFIG_BT_DEVICE_NAME="PuckOff BLE RF"
CONFIG_BT_DIS_MODEL_NUMBER_STR="Experimental MPSL RF bridge"
CONFIG_CDC_ACM_SERIAL_PRODUCT_STRING="PuckOff BLE RF experiment"
CONFIG_SHELL_PROMPT_UART="ble-rf:~$ "

# Leave scheduling space for normal-priority proprietary radio requests.
CONFIG_BT_CTLR_SDC_MAX_CONN_EVENT_LEN_DEFAULT_OVERRIDE=y
CONFIG_BT_CTLR_SDC_MAX_CONN_EVENT_LEN_DEFAULT=1500
CONFIG_BT_CTLR_SDC_CONN_EVENT_EXTEND_DEFAULT=n
```

## app.overlay
```dts
/* SPDX-License-Identifier: Apache-2.0 */
/ {
	gamepad: gamepad {
		compatible = "zephyr,hid-device";
		label = "PuckOff Gamepad";
		protocol-code = "none";
		in-report-size = <16>;
		in-polling-period-us = <1000>;
	};
};
```

## ble-bridge.overlay
```dts
/* SPDX-License-Identifier: Apache-2.0 */
/*
 * Boot guard record: 128 bytes of RAM that neither the kernel nor the Adafruit
 * UF2 bootloader touches. The bootloader owns 0x20008000 and up (plus its
 * double-reset word at 0x20007F7C) and runs on every reset; the MBR uses the
 * first 8 bytes of RAM. The kernel's RAM starts after this region.
 */
/ {
	retained0: retained@20000080 {
		compatible = "zephyr,memory-region", "mmio-sram";
		reg = <0x20000080 0x80>;
		zephyr,memory-region = "RETAINED";
		status = "okay";
	};
};

&sram0 {
	reg = <0x20000100 0x3FF00>;
};
```

## ble-rf.overlay
```dts
/* SPDX-License-Identifier: Apache-2.0 */
/* Reserve SWI1/EGU1 for the timeslot backend's kernel-safe completion interrupt. */
&egu1 {
	status = "disabled";
};
```

## src/main.c
```c
/* SPDX-License-Identifier: Apache-2.0 */
/*
 * PuckOff: open receiver firmware for the Steam Controller.
 * Copyright 2026 New Ideas Unlimited, LLC and the PuckOff contributors.
 */
#include <stdlib.h>
#include <zephyr/kernel.h>
#include <zephyr/drivers/gpio.h>
#include <zephyr/logging/log.h>
#include <zephyr/sys/atomic.h>

#include "bond.h"
#include "boot_guard.h"
#include "gamepad.h"
#include "input.h"
#include "link.h"
#include "usb.h"
#ifdef CONFIG_PUCKOFF_TRANSPORT_BLE_BRIDGE
#include "ble/bridge.h"
#endif
#ifdef CONFIG_PUCKOFF_SNIFFER
#include "sniff.h"
#endif

LOG_MODULE_REGISTER(main, LOG_LEVEL_INF);

static const struct gpio_dt_spec led = GPIO_DT_SPEC_GET(DT_ALIAS(led0), gpios);
static int active_slot = -1;
static atomic_t watch;
static struct ctrl_state last_seen;

/* With a Bluetooth host connected, input goes there instead of USB. */
static void send_report(const struct ctrl_state *st, const struct gamepad_report *r)
{
#ifdef CONFIG_PUCKOFF_TRANSPORT_BLE_BRIDGE
	if (ble_bridge_input(st, r)) {
		return;
	}
#else
	ARG_UNUSED(st);
#endif
	usb_send_gamepad(r);
}

static void send_neutral(void)
{
	struct gamepad_report r;

#ifdef CONFIG_PUCKOFF_TRANSPORT_BLE_BRIDGE
	if (ble_bridge_lost()) {
		return;
	}
#endif
	gamepad_neutral(&r);
	usb_send_gamepad(&r);
}

void main_set_watch(bool on)
{
	atomic_set(&watch, on);
}

static void on_input(int slot, const struct ctrl_state *st)
{
	struct gamepad_report r;

	/* Keep the first input owner until it is explicitly released by the link. */
	if (active_slot >= 0 && active_slot != slot) {
		return;
	}
	active_slot = slot;
	gamepad_from_ctrl(st, &r);
#ifdef CONFIG_PUCKOFF_USB_SWITCH
	/* The console has no use for raw trackpads; let them stand in for the sticks. */
	gamepad_pads_as_sticks(st, &r);
#endif
	send_report(st, &r);

	if (atomic_get(&watch) && (st->buttons != last_seen.buttons ||
		      abs(st->lx - last_seen.lx) > 2000 || abs(st->ly - last_seen.ly) > 2000 ||
		      abs(st->rx - last_seen.rx) > 2000 || abs(st->ry - last_seen.ry) > 2000 ||
		      abs(st->lt - last_seen.lt) > 2000 || abs(st->rt - last_seen.rt) > 2000)) {
		last_seen = *st;
		printk("in%d btn=%08X L=(%6d,%6d) R=(%6d,%6d) LT=%5u RT=%5u\n", slot, st->buttons,
		       st->lx, st->ly, st->rx, st->ry, st->lt, st->rt);
	}
}

static void on_lost(int slot)
{
	if (slot == active_slot) {
		send_neutral();
		active_slot = -1;
		last_seen = (struct ctrl_state){0};
	}
}

int main(void)
{
	int err;
	bool have_led = gpio_is_ready_dt(&led);

	boot_guard_stage(BOOT_STAGE_MAIN);
	if (have_led) {
		err = gpio_pin_configure_dt(&led, GPIO_OUTPUT_INACTIVE);
		if (err) {
			LOG_WRN("LED setup failed (%d)", err);
			have_led = false;
		}
	}

	int storage_err = bond_init();

	if (storage_err) {
		LOG_ERR("pairing storage failed (%d); radio will not start", storage_err);
	}
	err = usb_start();
	if (err) {
		LOG_ERR("usb failed (%d)", err);
		return err;
	}
	boot_guard_stage(BOOT_STAGE_USB);
	if (storage_err) {
		return storage_err;
	}
	if (boot_guard_safe_mode()) {
		/* USB and the console are enough to read bootguard and reflash. */
		LOG_WRN("safe mode: not starting Bluetooth or the controller radio");
	} else {
#ifdef CONFIG_PUCKOFF_TRANSPORT_BLE_BRIDGE
		boot_guard_stage(BOOT_STAGE_BLUETOOTH);
		err = ble_bridge_start();
		if (err) {
			LOG_ERR("bluetooth failed (%d)", err);
			return err;
		}
#endif
		boot_guard_stage(BOOT_STAGE_RADIO);
#ifdef CONFIG_PUCKOFF_SNIFFER
		(void)on_input;
		(void)on_lost;
		err = sniff_start();
#else
		err = link_start(on_input, on_lost);
#endif
		if (err) {
			LOG_ERR("radio startup failed (%d)", err);
			return err;
		}
		boot_guard_stage(BOOT_STAGE_READY);
		LOG_INF("PuckOff ready");
	}

	/* LED: slow blink = searching, solid = connected, fast blink = not paired. */
	for (uint32_t t = 0;; t++) {
		bool paired = false;

		for (int i = 0; i < BOND_SLOTS; i++) {
			struct bond b;

			err = bond_snapshot(i, &b);
			if (err) {
				LOG_ERR("slot %d: bond snapshot failed (%d)", i, err);
			} else {
				paired |= b.used;
			}
		}
		if (have_led) {
			int value = link_any_connected() ? 1 : paired ? (t % 10) == 0 : t & 1;

			err = gpio_pin_set_dt(&led, value);
			if (err) {
				LOG_WRN("LED update failed (%d)", err);
				have_led = false;
			}
		}
		k_msleep(100);
	}
	return 0;
}
```

## src/bond.c
```c
/* SPDX-License-Identifier: Apache-2.0 */
#include "bond.h"

#include <errno.h>
#include <string.h>
#include <zephyr/kernel.h>
#include <zephyr/settings/settings.h>
#include <zephyr/sys/byteorder.h>

static struct bond bonds[BOND_SLOTS];
static K_MUTEX_DEFINE(bond_lock);
static struct k_spinlock bond_data_lock;
static bool storage_ready;
static struct bond loaded_bonds[BOND_SLOTS];
static bool loading;
static int load_error;

static void publish(int slot, const struct bond *b)
{
	k_spinlock_key_t key = k_spin_lock(&bond_data_lock);

	bonds[slot] = *b;
	k_spin_unlock(&bond_data_lock, key);
}

static void encode(const struct bond *b, uint8_t rec[BOND_RECORD_LEN])
{
	memset(rec, 0, BOND_RECORD_LEN);
	sys_put_le32(b->receiver_id, rec);
	sys_put_le32(b->controller_id, rec + 4);
	memcpy(rec + 8, b->serial, strnlen(b->serial, BOND_SERIAL_LEN));
}

static int decode(const uint8_t rec[BOND_RECORD_LEN], struct bond *b)
{
	bool padding = false;

	memset(b, 0, sizeof(*b));
	b->receiver_id = sys_get_le32(rec);
	b->controller_id = sys_get_le32(rec + 4);
	b->used = b->receiver_id != 0 || b->controller_id != 0;
	if (b->used && (b->receiver_id == 0 || b->controller_id == 0)) {
		return -EINVAL;
	}
	for (int i = 0; i < BOND_SERIAL_LEN; i++) {
		uint8_t c = rec[8 + i];

		if (c == 0) {
			padding = true;
		} else if (!b->used || padding || c < 0x21 || c > 0x7e) {
			return -EINVAL;
		}
		b->serial[i] = (char)c;
	}
	return 0;
}

static bool same_bond(const struct bond *a, const struct bond *b)
{
	return a->used == b->used && a->receiver_id == b->receiver_id &&
	       a->controller_id == b->controller_id && strcmp(a->serial, b->serial) == 0;
}

static int bond_settings_set(const char *name, size_t len, settings_read_cb read_cb,
			     void *cb_arg)
{
	uint8_t rec[BOND_RECORD_LEN];
	int slot, err = 0;

	if (!loading) {
		return -EACCES;
	}
	if (name == NULL || name[0] < '0' || name[0] >= '0' + BOND_SLOTS ||
	    name[1] != '\0' || (len != BOND_RECORD_LEN && len != 0)) {
		err = -EINVAL;
		goto fail;
	}
	slot = name[0] - '0';
	if (len == 0) {
		memset(&loaded_bonds[slot], 0, sizeof(loaded_bonds[slot]));
		return 0;
	}
	if (read_cb(cb_arg, rec, sizeof(rec)) != (ssize_t)sizeof(rec)) {
		err = -EIO;
		goto fail;
	}
	err = decode(rec, &loaded_bonds[slot]);
	if (err) {
		goto fail;
	}
	return 0;

fail:
	/* Some settings backends log handler errors without returning them to load. */
	if (!load_error) {
		load_error = err;
	}
	return err;
}

SETTINGS_STATIC_HANDLER_DEFINE(bond, "bond", NULL, bond_settings_set, NULL, NULL);

int bond_init(void)
{
	int err;

	k_mutex_lock(&bond_lock, K_FOREVER);
	if (bond_storage_ready()) {
		k_mutex_unlock(&bond_lock);
		return 0;
	}
	memset(loaded_bonds, 0, sizeof(loaded_bonds));
	load_error = 0;
	loading = true;
	err = settings_subsys_init();
	if (!err) {
		err = settings_load_subtree("bond");
	}
	loading = false;
	err = err ? err : load_error;
	if (!err) {
		k_spinlock_key_t key = k_spin_lock(&bond_data_lock);

		memcpy(bonds, loaded_bonds, sizeof(bonds));
		storage_ready = true;
		k_spin_unlock(&bond_data_lock, key);
	}
	k_mutex_unlock(&bond_lock);
	return err;
}

bool bond_storage_ready(void)
{
	k_spinlock_key_t key = k_spin_lock(&bond_data_lock);
	bool ready = storage_ready;

	k_spin_unlock(&bond_data_lock, key);
	return ready;
}

int bond_snapshot(int slot, struct bond *out)
{
	k_spinlock_key_t key;

	if (slot < 0 || slot >= BOND_SLOTS || out == NULL) {
		return -EINVAL;
	}
	key = k_spin_lock(&bond_data_lock);
	*out = bonds[slot];
	k_spin_unlock(&bond_data_lock, key);
	return 0;
}

int bond_export(uint8_t records[BOND_SLOTS][BOND_RECORD_LEN])
{
	struct bond snapshot[BOND_SLOTS];
	k_spinlock_key_t key;

	if (records == NULL) {
		return -EINVAL;
	}
	key = k_spin_lock(&bond_data_lock);
	if (!storage_ready) {
		k_spin_unlock(&bond_data_lock, key);
		return -EACCES;
	}
	memcpy(snapshot, bonds, sizeof(snapshot));
	k_spin_unlock(&bond_data_lock, key);
	for (int i = 0; i < BOND_SLOTS; i++) {
		encode(&snapshot[i], records[i]);
	}
	return 0;
}

static int save(int slot, const struct bond *candidate)
{
	char key[12];
	uint8_t rec[BOND_RECORD_LEN];

	snprintk(key, sizeof(key), "bond/%d", slot);
	encode(candidate, rec);
	return settings_save_one(key, rec, sizeof(rec));
}

static int update(int slot, const struct bond *candidate, const struct bond *expected,
		  bool overwrite)
{
	struct bond current;
	int err;

	if (slot < 0 || slot >= BOND_SLOTS) {
		return -EINVAL;
	}
	k_mutex_lock(&bond_lock, K_FOREVER);
	if (!bond_storage_ready()) {
		err = -EACCES;
		goto done;
	}
	bond_snapshot(slot, &current);
	if ((expected != NULL && !same_bond(&current, expected)) ||
	    (!overwrite && current.used && !same_bond(&current, candidate))) {
		err = -EAGAIN;
		goto done;
	}
	if (same_bond(&current, candidate)) {
		err = 0;
		goto done;
	}
	if (candidate->used) {
		for (int i = 0; i < BOND_SLOTS; i++) {
			struct bond other;

			bond_snapshot(i, &other);
			if (i != slot && other.used &&
			    other.controller_id == candidate->controller_id) {
				err = -EAGAIN;
				goto done;
			}
		}
	}
	err = save(slot, candidate);
	if (!err) {
		publish(slot, candidate);
	}

done:
	k_mutex_unlock(&bond_lock);
	return err;
}

int bond_import(int slot, const uint8_t record[BOND_RECORD_LEN],
		const uint8_t expected[BOND_RECORD_LEN])
{
	struct bond candidate, before;

	if (record == NULL || expected == NULL || decode(record, &candidate) ||
	    !candidate.used || decode(expected, &before)) {
		return -EINVAL;
	}
	return update(slot, &candidate, &before, true);
}

int bond_clear_if(int slot, const uint8_t expected[BOND_RECORD_LEN])
{
	const struct bond empty = {0};
	struct bond before;

	if (expected == NULL || decode(expected, &before)) {
		return -EINVAL;
	}
	return update(slot, &empty, &before, true);
}

int bond_set(int slot, uint32_t receiver_id, uint32_t controller_id, const char *serial)
{
	struct bond candidate = {
		.used = true,
		.receiver_id = receiver_id,
		.controller_id = controller_id,
	};
	size_t len = serial == NULL ? 0 : strnlen(serial, BOND_SERIAL_LEN + 1);

	if (receiver_id == 0 || controller_id == 0 || len > BOND_SERIAL_LEN) {
		return -EINVAL;
	}
	for (size_t i = 0; i < len; i++) {
		if ((unsigned char)serial[i] < 0x21 || (unsigned char)serial[i] > 0x7e) {
			return -EINVAL;
		}
		candidate.serial[i] = serial[i];
	}
	return update(slot, &candidate, NULL, false);
}

int bond_clear(int slot)
{
	const struct bond empty = {0};

	return update(slot, &empty, NULL, true);
}
```

## src/bond.h
```c
/* SPDX-License-Identifier: Apache-2.0 */
#pragma once
#include <stdint.h>
#include <stdbool.h>

#define BOND_SLOTS 4
#define BOND_SERIAL_LEN 16

/*
 * A pairing between this receiver and one controller. The wire format
 * (BOND_RECORD_LEN bytes) is the same one Valve's receiver uses, so a pairing
 * can be moved between receivers.
 */
struct bond {
	bool used;
	uint32_t receiver_id;
	uint32_t controller_id;
	char serial[BOND_SERIAL_LEN + 1];
};

#define BOND_RECORD_LEN (4 + 4 + BOND_SERIAL_LEN)

int bond_init(void);
bool bond_storage_ready(void);
/* Copies a coherent value without holding a lock during flash I/O. */
int bond_snapshot(int slot, struct bond *out);
/* Exports one coherent table. Empty slots are all-zero records. */
int bond_export(uint8_t records[BOND_SLOTS][BOND_RECORD_LEN]);
/* Both mutations compare the current record with expected before writing. */
int bond_import(int slot, const uint8_t record[BOND_RECORD_LEN],
		const uint8_t expected[BOND_RECORD_LEN]);
int bond_clear_if(int slot, const uint8_t expected[BOND_RECORD_LEN]);
/* Legacy recovery API: set refuses replacement; clear is explicitly destructive. */
int bond_set(int slot, uint32_t receiver_id, uint32_t controller_id, const char *serial);
int bond_clear(int slot);
```

## src/boot_guard.c
```c
/* SPDX-License-Identifier: Apache-2.0 */
/*
 * Copyright 2026 New Ideas Unlimited, LLC and the PuckOff contributors.
 *
 * The nRF52840 watchdog cannot be stopped once started and keeps counting
 * through a soft reset, so the firmware never soft-resets with it running.
 * Entering the UF2 drive lets the watchdog perform the reset: a watchdog reset
 * clears the watchdog itself, and the Adafruit bootloader reads the retained
 * GPREGRET magic exactly as it does after the original `bootloader` command.
 *
 * The record lives in the RETAINED region from ble-bridge.overlay, outside the
 * RAM the bootloader zeroes on every reset and outside the kernel's own RAM.
 */
#include "boot_guard.h"

#include <string.h>
#include <zephyr/kernel.h>
#include <zephyr/fatal.h>
#include <zephyr/init.h>
#include <zephyr/logging/log.h>
#include <zephyr/sys/atomic.h>
#include <zephyr/sys/reboot.h>
#include <hal/nrf_power.h>
#include <hal/nrf_wdt.h>

#ifdef __ZEPHYR__
#include <zephyr/devicetree.h>
#if !DT_NODE_HAS_STATUS(DT_NODELABEL(retained0), okay)
#error "The boot guard needs the retained0 region: build with ble-bridge.overlay"
#endif
#endif

#ifndef BOOT_GUARD_HALT
/* Interrupts are already locked here; the watchdog ends the wait. */
#define BOOT_GUARD_HALT() for (;;) { }
#endif

LOG_MODULE_REGISTER(boot_guard, LOG_LEVEL_INF);

#define GUARD_MAGIC 0x50754F46u /* "PuOF" */
/* Value the Adafruit UF2 bootloader checks to stay on the drive. */
#define UF2_BOOTLOADER_MAGIC 0x57u
#define WDT_HZ 32768u
#define FEED_PERIOD_MS (CONFIG_PUCKOFF_BOOT_GUARD_TIMEOUT_S * 1000 / 4)

BUILD_ASSERT(CONFIG_PUCKOFF_BOOT_GUARD_TIMEOUT_S >= 2, "a shorter watchdog cannot cover boot");

struct retained {
	uint32_t magic;
	uint8_t stage;
	uint8_t detail;
	uint8_t watchdog_resets;
	uint8_t fault;
	uint32_t fault_code;
	uint32_t fault_pc;
	char fault_file[BOOT_FAULT_FILE_LEN];
};

static volatile struct retained guard Z_GENERIC_SECTION(RETAINED);
static struct boot_guard_status status;
static atomic_t feeding;
static bool feed_scheduled;

static void feed_work_handler(struct k_work *work);
static K_WORK_DELAYABLE_DEFINE(feed_work, feed_work_handler);

void boot_guard_decide(bool watchdog_reset, uint8_t previous_stage, uint8_t watchdog_resets,
		       struct boot_guard_decision *out)
{
	out->safe_mode = false;
	out->bootloader = false;
	if (!watchdog_reset) {
		return;
	}
	switch (previous_stage) {
	case BOOT_STAGE_UNKNOWN:
	case BOOT_STAGE_KERNEL:
	case BOOT_STAGE_BOOTLOADER:
		/* Hung before main(), or interrupted on the way to the drive. */
		out->bootloader = true;
		return;
	case BOOT_STAGE_READY:
		out->safe_mode = watchdog_resets >= CONFIG_PUCKOFF_BOOT_GUARD_MAX_RUNTIME_RESETS;
		return;
	default:
		out->safe_mode = true;
		return;
	}
}

const char *boot_stage_name(uint8_t stage)
{
	static const char *const names[] = {
		"unknown", "kernel", "main", "usb", "bluetooth", "radio", "ready", "bootloader",
	};

	return stage < ARRAY_SIZE(names) ? names[stage] : "invalid";
}

const char *boot_fault_name(uint8_t fault)
{
	static const char *const names[] = { "none", "kernel", "mpsl", "controller" };

	return fault < ARRAY_SIZE(names) ? names[fault] : "invalid";
}

static void feed_work_handler(struct k_work *work)
{
	ARG_UNUSED(work);
	if (!atomic_get(&feeding)) {
		return;
	}
	nrf_wdt_reload_request_set(NRF_WDT, NRF_WDT_RR0);
	k_work_reschedule(&feed_work, K_MSEC(FEED_PERIOD_MS));
}

static void clear_fault(void)
{
	guard.fault = BOOT_FAULT_NONE;
	guard.fault_code = 0;
	guard.fault_pc = 0;
	for (int i = 0; i < BOOT_FAULT_FILE_LEN; i++) {
		guard.fault_file[i] = 0;
	}
}

static int boot_guard_early(void)
{
	uint32_t cause = nrf_power_resetreas_get(NRF_POWER);
	bool watchdog = (cause & NRF_POWER_RESETREAS_DOG_MASK) != 0;
	uint8_t previous = BOOT_STAGE_UNKNOWN;
	uint8_t resets = 0;
	struct boot_guard_decision decision;

	/* The bootloader leaves RESETREAS alone; it is this application's to clear. */
	nrf_power_resetreas_clear(NRF_POWER, 0xFFFFFFFFu);
	memset(&status, 0, sizeof(status));
	if (guard.magic == GUARD_MAGIC) {
		previous = guard.stage;
		resets = guard.watchdog_resets;
		status.previous_detail = guard.detail;
		status.fault = guard.fault;
		status.fault_code = guard.fault_code;
		status.fault_pc = guard.fault_pc;
		for (int i = 0; i < BOOT_FAULT_FILE_LEN; i++) {
			status.fault_file[i] = guard.fault_file[i];
		}
		status.fault_file[BOOT_FAULT_FILE_LEN - 1] = 0;
	}
	if (watchdog) {
		resets = resets < UINT8_MAX ? resets + 1 : UINT8_MAX;
	} else {
		resets = 0;
	}
	boot_guard_decide(watchdog, previous, resets, &decision);

	status.reset_cause = cause;
	status.previous_stage = previous;
	status.watchdog_resets = resets;
	status.safe_mode = decision.safe_mode;
	status.timeout_s = CONFIG_PUCKOFF_BOOT_GUARD_TIMEOUT_S;

	guard.magic = GUARD_MAGIC;
	guard.watchdog_resets = resets;
	guard.detail = BOOT_DETAIL_NONE;
	clear_fault();
	if (decision.bootloader) {
		guard.stage = BOOT_STAGE_BOOTLOADER;
		nrf_power_gpregret_set(NRF_POWER, 0, UF2_BOOTLOADER_MAGIC);
		sys_reboot(SYS_REBOOT_COLD);
		return 0;
	}
	guard.stage = BOOT_STAGE_KERNEL;

	if (nrf_wdt_started_check(NRF_WDT)) {
		/* Inherited from the previous run across a soft reset; it cannot be reconfigured. */
		status.watchdog_running = true;
	} else {
		nrf_wdt_behaviour_set(NRF_WDT, NRF_WDT_BEHAVIOUR_RUN_SLEEP_MASK);
		nrf_wdt_reload_value_set(NRF_WDT, CONFIG_PUCKOFF_BOOT_GUARD_TIMEOUT_S * WDT_HZ - 1);
		nrf_wdt_reload_request_enable(NRF_WDT, NRF_WDT_RR0);
		nrf_wdt_task_trigger(NRF_WDT, NRF_WDT_TASK_START);
		status.watchdog_running = true;
	}
	atomic_set(&feeding, 1);
	return 0;
}
SYS_INIT(boot_guard_early, PRE_KERNEL_1, 0);

void boot_guard_stage(enum boot_stage stage)
{
	guard.stage = stage;
	guard.detail = BOOT_DETAIL_NONE;
	if (!feed_scheduled && status.watchdog_running) {
		/* The system work queue exists once main() runs; a wedged queue is a hang. */
		feed_scheduled = true;
		k_work_schedule(&feed_work, K_NO_WAIT);
	}
	if (status.safe_mode && stage == BOOT_STAGE_USB) {
		LOG_ERR("safe mode: the previous boot hung at stage %s/%u (%s fault) after %u "
			"watchdog reset(s); Bluetooth and the controller radio stay off",
			boot_stage_name(status.previous_stage), status.previous_detail,
			boot_fault_name(status.fault), status.watchdog_resets);
	}
}

void boot_guard_detail(uint8_t detail)
{
	guard.detail = detail;
}

bool boot_guard_safe_mode(void)
{
	return status.safe_mode;
}

void boot_guard_get_status(struct boot_guard_status *out)
{
	*out = status;
}

int boot_guard_request_bootloader(void)
{
	guard.stage = BOOT_STAGE_BOOTLOADER;
	nrf_power_gpregret_set(NRF_POWER, 0, UF2_BOOTLOADER_MAGIC);
	if (!status.watchdog_running) {
		sys_reboot(SYS_REBOOT_COLD);
		return 0;
	}
	atomic_set(&feeding, 0);
	(void)k_work_cancel_delayable(&feed_work);
	return 0;
}

static void record_fault(uint8_t fault, uint32_t code, uint32_t pc, const char *file)
{
	size_t len = 0;

	if (guard.magic != GUARD_MAGIC) {
		return;
	}
	guard.fault = fault;
	guard.fault_code = code;
	guard.fault_pc = pc;
	if (file) {
		/* Keep the end of the path: the file name, not the directories. */
		len = strlen(file);
		if (len > BOOT_FAULT_FILE_LEN - 1) {
			file += len - (BOOT_FAULT_FILE_LEN - 1);
			len = BOOT_FAULT_FILE_LEN - 1;
		}
	}
	for (size_t i = 0; i < BOOT_FAULT_FILE_LEN; i++) {
		guard.fault_file[i] = i < len ? file[i] : 0;
	}
}

/* Zephyr's fatal error hook: record what happened and let the watchdog reset. */
void k_sys_fatal_error_handler(unsigned int reason, const struct arch_esf *esf)
{
	record_fault(BOOT_FAULT_KERNEL, reason, esf ? esf->basic.pc : 0, NULL);
	BOOT_GUARD_HALT();
}

#ifdef CONFIG_MPSL_ASSERT_HANDLER
void mpsl_assert_handle(char *file, uint32_t line)
{
	record_fault(BOOT_FAULT_MPSL, line, 0, file);
	BOOT_GUARD_HALT();
}
#endif

#ifdef CONFIG_BT_CTLR_ASSERT_HANDLER
void bt_ctlr_assert_handle(char *file, uint32_t line)
{
	record_fault(BOOT_FAULT_CTLR, line, 0, file);
	BOOT_GUARD_HALT();
}
#endif
```

## src/boot_guard.h
```c
/* SPDX-License-Identifier: Apache-2.0 */
/*
 * Boot guard: a hardware watchdog armed before the kernel, boot-stage markers
 * in retained RAM, and a small policy that turns a hung boot into a boot that
 * can be inspected (safe mode) or reflashed (the UF2 drive) without a paperclip.
 * Copyright 2026 New Ideas Unlimited, LLC and the PuckOff contributors.
 */
#pragma once
#include <stdbool.h>
#include <stdint.h>

/* Stages are ordered: a later stage means more of the firmware came up. */
enum boot_stage {
	BOOT_STAGE_UNKNOWN = 0,    /* retained memory held no valid record */
	BOOT_STAGE_KERNEL = 1,     /* guard armed; kernel and drivers initializing */
	BOOT_STAGE_MAIN = 2,       /* main() entered */
	BOOT_STAGE_USB = 3,        /* USB device started */
	BOOT_STAGE_BLUETOOTH = 4,  /* Bluetooth stack starting */
	BOOT_STAGE_RADIO = 5,      /* controller radio starting */
	BOOT_STAGE_READY = 6,      /* every transport running */
	BOOT_STAGE_BOOTLOADER = 7, /* deliberately on the way to the UF2 drive */
};

/* Finer progress inside a stage; the meaning is documented where it is set. */
#define BOOT_DETAIL_NONE 0

/* What ended the previous run, besides the watchdog itself. */
enum boot_fault {
	BOOT_FAULT_NONE = 0,
	BOOT_FAULT_KERNEL = 1, /* k_sys_fatal_error_handler: code is the kernel reason */
	BOOT_FAULT_MPSL = 2,   /* MPSL assertion: file and line */
	BOOT_FAULT_CTLR = 3,   /* SoftDevice Controller assertion: file and line */
};

#define BOOT_FAULT_FILE_LEN 12

struct boot_guard_decision {
	bool safe_mode;  /* start USB and the console only */
	bool bootloader; /* go straight to the UF2 drive, without a watchdog */
};

struct boot_guard_status {
	uint32_t reset_cause;    /* raw RESETREAS captured at this boot */
	uint8_t previous_stage;  /* enum boot_stage the previous run reached */
	uint8_t previous_detail;
	uint8_t watchdog_resets; /* consecutive watchdog resets, this one included */
	uint8_t fault;           /* enum boot_fault of the previous run */
	uint32_t fault_code;     /* kernel reason or assertion line */
	uint32_t fault_pc;       /* faulting instruction for kernel faults */
	char fault_file[BOOT_FAULT_FILE_LEN];
	bool safe_mode;
	bool watchdog_running;
	uint16_t timeout_s;
};

/*
 * Pure policy, shared with the host tests. A boot after a watchdog reset is
 * normal when the previous run was fully up (until too many in a row), safe
 * mode when the previous run hung after main() started, and the bootloader
 * when it hung before main() or while already heading for the UF2 drive.
 */
void boot_guard_decide(bool watchdog_reset, uint8_t previous_stage, uint8_t watchdog_resets,
		       struct boot_guard_decision *out);
const char *boot_stage_name(uint8_t stage);
const char *boot_fault_name(uint8_t fault);

#ifdef CONFIG_PUCKOFF_BOOT_GUARD
void boot_guard_stage(enum boot_stage stage);
void boot_guard_detail(uint8_t detail);
bool boot_guard_safe_mode(void);
void boot_guard_get_status(struct boot_guard_status *out);
/*
 * Arm a reboot into the UF2 drive. With the watchdog running, this stops
 * feeding it and returns 0: the caller must idle until the watchdog resets
 * the chip (at most the configured timeout). Without a watchdog it reboots
 * immediately and does not return.
 */
int boot_guard_request_bootloader(void);
#else
static inline void boot_guard_stage(enum boot_stage stage)
{
	(void)stage;
}
static inline void boot_guard_detail(uint8_t detail)
{
	(void)detail;
}
static inline bool boot_guard_safe_mode(void)
{
	return false;
}
#endif
```

## src/gamepad.c
```c
/* SPDX-License-Identifier: Apache-2.0 */
/* Generic HID: 16 buttons, a hat, two sticks and two analog triggers. */
#include "gamepad.h"
#include <string.h>
#include <zephyr/usb/class/hid.h>

_Static_assert(sizeof(struct gamepad_report) == GAMEPAD_REPORT_SIZE, "gamepad layout");

const uint8_t gamepad_hid_desc[] = {
	HID_USAGE_PAGE(HID_USAGE_GEN_DESKTOP),
	HID_USAGE(HID_USAGE_GEN_DESKTOP_GAMEPAD),
	HID_COLLECTION(HID_COLLECTION_APPLICATION),

	/* 16 buttons */
	HID_USAGE_PAGE(HID_USAGE_GEN_BUTTON),
	HID_USAGE_MIN8(1),
	HID_USAGE_MAX8(16),
	HID_LOGICAL_MIN8(0),
	HID_LOGICAL_MAX8(1),
	HID_REPORT_SIZE(1),
	HID_REPORT_COUNT(16),
	HID_INPUT(0x02),

	/* D-pad as a hat switch, plus 4 bits padding */
	HID_USAGE_PAGE(HID_USAGE_GEN_DESKTOP),
	HID_USAGE(0x39),
	HID_LOGICAL_MIN8(0),
	HID_LOGICAL_MAX8(7),
	0x35, 0x00,       /* Physical Minimum (0) */
	0x46, 0x3B, 0x01, /* Physical Maximum (315) */
	0x65, 0x14,       /* Unit (degrees) */
	HID_REPORT_SIZE(4),
	HID_REPORT_COUNT(1),
	HID_INPUT(0x42), /* null state = centered */
	0x65, 0x00,       /* Unit (none) */
	HID_REPORT_COUNT(1),
	HID_INPUT(0x03),
	0x45, 0x00, /* Physical range 0..0: subsequent axes use their logical range. */

	/* Sticks: X/Y left, Z/Rz right */
	HID_USAGE(HID_USAGE_GEN_DESKTOP_X),
	HID_USAGE(HID_USAGE_GEN_DESKTOP_Y),
	HID_USAGE(0x32),
	HID_USAGE(0x35),
	HID_LOGICAL_MIN16(0x01, 0x80), /* -32767 */
	HID_LOGICAL_MAX16(0xFF, 0x7F), /* 32767 */
	HID_REPORT_SIZE(16),
	HID_REPORT_COUNT(4),
	HID_INPUT(0x02),

	/* Triggers: Rx left, Ry right */
	HID_USAGE(0x33),
	HID_USAGE(0x34),
	HID_LOGICAL_MIN8(0),
	HID_LOGICAL_MAX16(0xFF, 0x00),
	HID_REPORT_SIZE(8),
	HID_REPORT_COUNT(2),
	HID_INPUT(0x02),

	HID_END_COLLECTION,
};
const size_t gamepad_hid_desc_len = sizeof(gamepad_hid_desc);

static const struct {
	uint32_t ctrl;
	uint16_t hid;
} button_map[] = {
	{ BTN_A, GAMEPAD_A },       { BTN_B, GAMEPAD_B },
	{ BTN_X, GAMEPAD_X },       { BTN_Y, GAMEPAD_Y },
	{ BTN_LB, GAMEPAD_LB },     { BTN_RB, GAMEPAD_RB },
	{ BTN_VIEW, GAMEPAD_VIEW }, { BTN_MENU, GAMEPAD_MENU },
	{ BTN_L3, GAMEPAD_L3 },     { BTN_R3, GAMEPAD_R3 },
	{ BTN_STEAM, GAMEPAD_HOME }, { BTN_QAM, GAMEPAD_QAM },
	{ BTN_L4, GAMEPAD_L4 },     { BTN_R4, GAMEPAD_R4 },
	{ BTN_L5, GAMEPAD_L5 },     { BTN_R5, GAMEPAD_R5 },
};

static uint8_t hat_from(uint32_t b)
{
	bool up = b & BTN_DUP, down = b & BTN_DDOWN;
	bool left = b & BTN_DLEFT, right = b & BTN_DRIGHT;

	if (up && down) {
		up = down = false;
	}
	if (left && right) {
		left = right = false;
	}
	if (up) {
		return right ? 1 : left ? 7 : 0;
	}
	if (down) {
		return right ? 3 : left ? 5 : 4;
	}
	if (right) {
		return 2;
	}
	if (left) {
		return 6;
	}
	return 8;
}

static int16_t flip(int16_t v)
{
	return v == INT16_MIN ? INT16_MAX : (int16_t)-v;
}

static uint8_t trigger8(uint16_t v, bool clicked)
{
	uint16_t t = v >> 7;

	if (clicked || t > 255) {
		return 255;
	}
	return (uint8_t)t;
}

void gamepad_neutral(struct gamepad_report *out)
{
	memset(out, 0, sizeof(*out));
	out->hat = 8;
}

void gamepad_from_ctrl(const struct ctrl_state *in, struct gamepad_report *out)
{
	gamepad_neutral(out);
	for (size_t i = 0; i < sizeof(button_map) / sizeof(button_map[0]); i++) {
		if (in->buttons & button_map[i].ctrl) {
			out->buttons |= button_map[i].hid;
		}
	}
	out->hat = hat_from(in->buttons);
	out->lx = in->lx == INT16_MIN ? -INT16_MAX : in->lx;
	out->ly = flip(in->ly);
	out->rx = in->rx == INT16_MIN ? -INT16_MAX : in->rx;
	out->ry = flip(in->ry);
	out->lt = trigger8(in->lt, in->buttons & BTN_LT_CLICK);
	out->rt = trigger8(in->rt, in->buttons & BTN_RT_CLICK);
}

void gamepad_pads_as_sticks(const struct ctrl_state *in, struct gamepad_report *out)
{
	if (in->buttons & BTN_LPAD_TOUCH) {
		out->lx = in->lpad_x == INT16_MIN ? -INT16_MAX : in->lpad_x;
		out->ly = flip(in->lpad_y);
	}
	if (in->buttons & BTN_RPAD_TOUCH) {
		out->rx = in->rpad_x == INT16_MIN ? -INT16_MAX : in->rpad_x;
		out->ry = flip(in->rpad_y);
	}
}

static void put16(uint8_t *out, uint16_t value)
{
	out[0] = (uint8_t)value;
	out[1] = (uint8_t)(value >> 8);
}

void gamepad_encode_generic(const struct gamepad_report *in,
			    uint8_t out[GAMEPAD_REPORT_SIZE])
{
	put16(out, in->buttons);
	out[2] = in->hat;
	put16(out + 3, (uint16_t)in->lx);
	put16(out + 5, (uint16_t)in->ly);
	put16(out + 7, (uint16_t)in->rx);
	put16(out + 9, (uint16_t)in->ry);
	out[11] = in->lt;
	out[12] = in->rt;
}
```

## src/gamepad.h
```c
/* SPDX-License-Identifier: Apache-2.0 */
#pragma once
#include <stdint.h>
#include <stddef.h>
#include <zephyr/toolchain.h>
#include "input.h"

#define GAMEPAD_REPORT_SIZE 13

enum gamepad_button {
	GAMEPAD_A = 1u << 0,
	GAMEPAD_B = 1u << 1,
	GAMEPAD_X = 1u << 2,
	GAMEPAD_Y = 1u << 3,
	GAMEPAD_LB = 1u << 4,
	GAMEPAD_RB = 1u << 5,
	GAMEPAD_VIEW = 1u << 6,
	GAMEPAD_MENU = 1u << 7,
	GAMEPAD_L3 = 1u << 8,
	GAMEPAD_R3 = 1u << 9,
	GAMEPAD_HOME = 1u << 10,
	GAMEPAD_QAM = 1u << 11,
	GAMEPAD_L4 = 1u << 12,
	GAMEPAD_R4 = 1u << 13,
	GAMEPAD_L5 = 1u << 14,
	GAMEPAD_R5 = 1u << 15,
};

/* Generic USB HID gamepad report (no report id). */
struct __packed gamepad_report {
	uint16_t buttons;
	uint8_t hat; /* 0 = up, clockwise to 7; 8 = centered */
	int16_t lx, ly, rx, ry; /* HID convention: +Y is down */
	uint8_t lt, rt;
};

extern const uint8_t gamepad_hid_desc[];
extern const size_t gamepad_hid_desc_len;

void gamepad_from_ctrl(const struct ctrl_state *in, struct gamepad_report *out);
void gamepad_neutral(struct gamepad_report *out);
/*
 * While a finger rests on a trackpad, that pad's position replaces the stick on
 * the same side, so a pad can be used like a thumbstick. Pads not touched leave
 * the sticks as gamepad_from_ctrl() set them.
 */
void gamepad_pads_as_sticks(const struct ctrl_state *in, struct gamepad_report *out);
/* Wire encoding is little-endian regardless of the CPU's byte order. */
void gamepad_encode_generic(const struct gamepad_report *in,
			    uint8_t out[GAMEPAD_REPORT_SIZE]);
```

## src/input.c
```c
/* SPDX-License-Identifier: Apache-2.0 */
#include "input.h"
#include "radio.h"
#include <string.h>

#define REPORT_STATE_LEGACY 0x45
#define REPORT_STATE 0x42
#define RECORD_HID_REPORT 6
#define MIN_STATE_LEN 0x1E /* through right pad force */
#define FULL_STATE_LEN 0x2E /* through gyro */

static uint16_t u16le(const uint8_t *p)
{
	return (uint16_t)(p[0] | p[1] << 8);
}

static int16_t s16le(const uint8_t *p)
{
	return (int16_t)u16le(p);
}

bool input_decode_report(const uint8_t *rep, size_t len, struct ctrl_state *out)
{
	if (rep == NULL || out == NULL || len < MIN_STATE_LEN ||
	    (rep[0] != REPORT_STATE_LEGACY && rep[0] != REPORT_STATE)) {
		return false;
	}

	memset(out, 0, sizeof(*out));
	out->report_id = rep[0];
	out->seq = rep[1];
	out->buttons = (uint32_t)rep[2] | (uint32_t)rep[3] << 8 |
		       (uint32_t)rep[4] << 16 | (uint32_t)rep[5] << 24;
	out->lt = u16le(rep + 0x06);
	out->rt = u16le(rep + 0x08);
	out->lx = s16le(rep + 0x0A);
	out->ly = s16le(rep + 0x0C);
	out->rx = s16le(rep + 0x0E);
	out->ry = s16le(rep + 0x10);
	out->lpad_x = s16le(rep + 0x12);
	out->lpad_y = s16le(rep + 0x14);
	out->lpad_force = u16le(rep + 0x16);
	out->rpad_x = s16le(rep + 0x18);
	out->rpad_y = s16le(rep + 0x1A);
	out->rpad_force = u16le(rep + 0x1C);

	if (len >= FULL_STATE_LEN) {
		out->has_imu = true;
		out->imu_time_us = (uint32_t)rep[0x1E] | (uint32_t)rep[0x1F] << 8 |
				   (uint32_t)rep[0x20] << 16 | (uint32_t)rep[0x21] << 24;
		for (int i = 0; i < 3; i++) {
			out->accel[i] = s16le(rep + 0x22 + 2 * i);
			out->gyro[i] = s16le(rep + 0x28 + 2 * i);
		}
	}
	return true;
}

bool input_from_packet(const uint8_t *pkt, size_t size, struct ctrl_state *out)
{
	struct ctrl_state latest;
	size_t end;
	size_t i = 3;
	bool found = false;

	if (pkt == NULL || out == NULL || size < 3 || pkt[0] < 1 ||
	    pkt[0] > RADIO_MAX_PAYLOAD || (size_t)pkt[0] + 2 > size || pkt[2] != 0xF1) {
		return false;
	}
	end = (size_t)pkt[0] + 2;
	while (i < end) {
		if (end - i < 2) {
			return false;
		}
		uint8_t rlen = pkt[i];
		uint8_t rtype = pkt[i + 1];
		const uint8_t *val = pkt + i + 2;

		if (rlen == 0 || rlen > end - i - 2) {
			return false;
		}
		if (rtype == RECORD_HID_REPORT) {
			if (input_decode_report(val, rlen, &latest)) {
				found = true;
			} else if (val[0] == REPORT_STATE_LEGACY || val[0] == REPORT_STATE) {
				return false;
			}
		}
		i += (size_t)rlen + 2;
	}
	if (found) {
		*out = latest;
	}
	return found;
}
```

## src/input.h
```c
/* SPDX-License-Identifier: Apache-2.0 */
#pragma once
#include <stdint.h>
#include <stddef.h>
#include <stdbool.h>

/* Controller button bits, as sent by the Steam Controller. */
enum ctrl_button {
	BTN_A = 1u << 0,
	BTN_B = 1u << 1,
	BTN_X = 1u << 2,
	BTN_Y = 1u << 3,
	BTN_QAM = 1u << 4,
	BTN_R3 = 1u << 5,
	BTN_MENU = 1u << 6, /* right of the Steam button ("start") */
	BTN_R4 = 1u << 7,
	BTN_R5 = 1u << 8,
	BTN_RB = 1u << 9,
	BTN_DDOWN = 1u << 10,
	BTN_DRIGHT = 1u << 11,
	BTN_DLEFT = 1u << 12,
	BTN_DUP = 1u << 13,
	BTN_VIEW = 1u << 14, /* left of the Steam button ("select") */
	BTN_L3 = 1u << 15,
	BTN_STEAM = 1u << 16,
	BTN_L4 = 1u << 17,
	BTN_L5 = 1u << 18,
	BTN_LB = 1u << 19,
	BTN_RS_TOUCH = 1u << 20,
	BTN_RPAD_TOUCH = 1u << 21,
	BTN_RPAD_CLICK = 1u << 22,
	BTN_RT_CLICK = 1u << 23,
	BTN_LS_TOUCH = 1u << 24,
	BTN_LPAD_TOUCH = 1u << 25,
	BTN_LPAD_CLICK = 1u << 26,
	BTN_LT_CLICK = 1u << 27,
	BTN_RGRIP_TOUCH = 1u << 28,
	BTN_LGRIP_TOUCH = 1u << 29,
};

/* Decoded controller state. Stick Y is positive = up. Triggers 0..32767. */
struct ctrl_state {
	uint8_t report_id;
	uint8_t seq;
	uint32_t buttons;
	uint16_t lt, rt;
	int16_t lx, ly, rx, ry;
	int16_t lpad_x, lpad_y;
	uint16_t lpad_force;
	int16_t rpad_x, rpad_y;
	uint16_t rpad_force;
	bool has_imu;
	uint32_t imu_time_us;
	int16_t accel[3];
	int16_t gyro[3];
};

/* Decode one raw input report (starting at its report id byte). */
bool input_decode_report(const uint8_t *rep, size_t len, struct ctrl_state *out);

/*
 * Scan a received radio packet ([length][S1][type][records...]) for input
 * reports within the supplied buffer size. Returns true only for a complete,
 * valid F1 packet containing input; *out holds its last report. On failure
 * *out is unchanged.
 */
bool input_from_packet(const uint8_t *pkt, size_t size, struct ctrl_state *out);
```

## src/link.h
```c
/* SPDX-License-Identifier: Apache-2.0 */
#pragma once
#include <stdint.h>
#include <stdbool.h>
#include "input.h"

struct link_stats {
	bool connected;
	bool powered_off;
	uint8_t rssi;
	uint32_t polls;
	uint32_t replies;
	uint32_t reports;
	uint32_t crc_errors;
	uint32_t last_reply_ms;
	uint32_t invalid_packets;
	uint32_t radio_errors;
	uint32_t deferred;
};

/* Called from the radio thread whenever fresh input arrives or a link drops. */
typedef void (*link_input_cb)(int slot, const struct ctrl_state *state);
typedef void (*link_lost_cb)(int slot);

/* Initialize synchronously; no radio thread is started on failure. */
int link_start(link_input_cb on_input, link_lost_cb on_lost);
/* Thread-safe snapshot; returns -EINVAL for an invalid slot or NULL output. */
int link_get_stats(int slot, struct link_stats *out);
bool link_any_connected(void);
void link_set_verbose(bool on);
```
